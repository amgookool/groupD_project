## sdkconfig.defaults
```kconfig
CONFIG_SUPPRESS_SELECT_DEBUG_OUTPUT=y
CONFIG_SUPPORT_TERMIOS=y

CONFIG_PARTITION_TABLE_CUSTOM=y
CONFIG_PARTITION_TABLE_CUSTOM_FILENAME="partitions_project.csv"
CONFIG_PARTITION_TABLE_FILENAME="partitions_project.csv"
```
